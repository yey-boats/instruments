## sdkconfig.defaults
```kconfig
# IDF-5 / pioarduino hybrid defaults. The pure-Arduino framework sets these
# implicitly; under the espidf hybrid (or pioarduino's IDF-5 build) they must be
# declared or the octal-PSRAM cache config mismatches and the app faults at
# entry (same silent-reboot signature as the qio_opi trap in CLAUDE.md).
CONFIG_FREERTOS_HZ=1000
CONFIG_SPIRAM_MODE_OCT=y
CONFIG_SPIRAM_SPEED_80M=y
CONFIG_ESP32S3_SPIRAM_SUPPORT=y
CONFIG_SPIRAM=y
# RGB LCD + PSRAM framebuffer: run the bounce-buffer refill ISR (and its GDMA
# callbacks) from IRAM so they don't touch flash/PSRAM while the cache is
# disabled during a flash write — prevents the "Cache disabled but cached
# memory region accessed" panic. Pairs with bounce_buffer_size_px in code.
CONFIG_LCD_RGB_ISR_IRAM_SAFE=y
CONFIG_GDMA_CTRL_FUNC_IN_IRAM=y
# Bluetooth via NimBLE (not Bluedroid). The precompiled Arduino build enabled
# these in its baked sdkconfig; the hybrid build regenerates sdkconfig from this
# file, so without them NimBLE-Arduino's headers hit "#if with no expression"
# (CONFIG_BT_* undefined). NimBLE = the small-footprint host (Bluedroid off).
CONFIG_BT_ENABLED=y
CONFIG_BT_BLUEDROID_ENABLED=n
CONFIG_BT_NIMBLE_ENABLED=y
# A.1 link fix: arduino-esp32's NetworkClientSecure/ssl_client.cpp wraps its ENTIRE
# body (start_ssl_client, ssl_init, send_ssl_data, ...) in
# `#if defined(MBEDTLS_KEY_EXCHANGE_SOME_PSK_ENABLED) ... #else #warning #endif`.
# The stock precompiled Arduino sdkconfig enables PSK ciphersuites, so that macro
# is defined and the bodies compile. Our hybrid regenerates sdkconfig from THIS
# file, and without PSK the macro is undefined -> ssl_client.cpp.o is EMPTY ->
# "undefined reference to start_ssl_client / ssl_init / ..." at link (HTTPClient
# pulls NetworkClientSecure even though we use no TLS yet). Enabling PSK key
# exchange restores the symbol bodies. See spec 21 §A.1.
CONFIG_MBEDTLS_PSK_MODES=y
CONFIG_MBEDTLS_KEY_EXCHANGE_PSK=y
# Hybrid (arduino + espidf): make the Arduino core provide app_main() that
# spins up the loopTask and calls setup()/loop(). Without it the link fails with
# "undefined reference to app_main" (espidf expects an app_main we don't define;
# our code is Arduino setup()/loop()).
CONFIG_AUTOSTART_ARDUINO=y
```
